## boards/shields/zmk_practice01/Kconfig.defconfig
```kconfig
if SHIELD_ZMK_PRACTICE01_LEFT

config ZMK_KEYBOARD_NAME
    default "zmk-practice01"

config ZMK_SPLIT_ROLE_CENTRAL
    default y

endif # SHIELD_ZMK_PRACTICE01_LEFT

if SHIELD_ZMK_PRACTICE01_LEFT || SHIELD_ZMK_PRACTICE01_RIGHT

config ZMK_SPLIT
    default y

endif # SHIELD_ZMK_PRACTICE01_LEFT || SHIELD_ZMK_PRACTICE01_RIGHT
```

## boards/shields/zmk_practice01/Kconfig.shield
```kconfig
config SHIELD_ZMK_PRACTICE01_LEFT
    def_bool $(shields_list_contains,zmk_practice01_left)

config SHIELD_ZMK_PRACTICE01_RIGHT
    def_bool $(shields_list_contains,zmk_practice01_right)
```
